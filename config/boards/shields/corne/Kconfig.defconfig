## config/boards/shields/corne/Kconfig.defconfig
```kconfig
# Split keyboard support
if SHIELD_CORNE_LEFT || SHIELD_CORNE_RIGHT || SHIELD_CORNE_LEFT_PERIPHERAL || SHIELD_CORNE_DONGLE
config ZMK_SPLIT
    default y
config ZMK_SPLIT_BLE
    default y
endif

# Dongle: Central role and battery proxy
if SHIELD_CORNE_LEFT || SHIELD_CORNE_DONGLE
config ZMK_KEYBOARD_NAME
    default "Corne"

config ZMK_SPLIT_ROLE_CENTRAL
    default y

config ZMK_SPLIT_BLE_CENTRAL_BATTERY_LEVEL_FETCHING
    default y

config ZMK_SPLIT_BLE_CENTRAL_BATTERY_LEVEL_PROXY
    default y
endif

# Dongle display: enable hardware drivers
if SHIELD_CORNE_DONGLE

if ZMK_DISPLAY

config I2C
    default y

config SSD1306
    default y

choice ZMK_DISPLAY_WORK_QUEUE
    default ZMK_DISPLAY_WORK_QUEUE_DEDICATED
endchoice

if LVGL

config LV_Z_VDB_SIZE
    default 32

config LV_DPI_DEF
    default 148

config LV_Z_BITS_PER_PIXEL
    default 1

choice LV_COLOR_DEPTH
    default LV_COLOR_DEPTH_1
endchoice

endif # LVGL

endif # ZMK_DISPLAY

endif # SHIELD_CORNE_DONGLE
```

## config/boards/shields/dongle_display/Kconfig
```kconfig
# Copyright (c) 2024 The ZMK Contributors
# SPDX-License-Identifier: MIT

config ZMK_DONGLE_DISPLAY_BONGO_CAT
	bool "Bongo cat animation widget"
	default y
	help
	  Enable bongo cat animation on the dongle display.

config ZMK_DONGLE_DISPLAY_MODIFIERS
	bool "Modifier status widget"
	default y
	help
	  Enable modifier key status display on the dongle display.

config ZMK_DONGLE_DISPLAY_LAYER
	bool "Layer status widget"
	default y
	help
	  Enable layer status display on the dongle display.

config ZMK_DONGLE_DISPLAY_WPM
	bool "Words per minute widget"
	default y
	help
	  Enable WPM counter display on the dongle display.

config ZMK_DONGLE_DISPLAY_DONGLE_BATTERY
	bool "Include dongle battery level in widget"
	default y
	help
	  Show dongle's own battery level alongside peripheral battery.

config ZMK_DONGLE_DISPLAY_MAC_MODIFIERS
	bool "Show Mac-specific modifier symbols"
	default n
	help
	  Use Mac-specific symbols (⌘⌥⌃⇧) for modifier display.

config ZMK_DONGLE_DISPLAY_WPM_DISABLED_LAYERS
	string "Layer names to disable WPM on"
	default ""
	help
	  Comma-separated list of layer names where WPM counter is disabled.

config ZMK_DONGLE_DISPLAY_LAYER_NAME_SCROLL_WIDTH
	int "Max width in pixels for scrolling layer name"
	default 30
	range 1 128
	help
	  Maximum width for the layer name text before it starts scrolling.

config ZMK_DONGLE_DISPLAY_LAYER_TEXT_ALIGN
	string "Text alignment for layer name"
	default "left"
	help
	  Text alignment for the layer name label. Options: "left", "center", "right".
```

## config/boards/shields/dongle_display/Kconfig.defconfig
```kconfig
# Copyright (c) 2024 The ZMK Contributors
# SPDX-License-Identifier: MIT

if SHIELD_DONGLE_DISPLAY

choice ZMK_DISPLAY_STATUS_SCREEN
    default ZMK_DISPLAY_STATUS_SCREEN_CUSTOM
endchoice

config ZMK_DISPLAY_STATUS_SCREEN_CUSTOM
    select LV_USE_LABEL
    select LV_FONT_UNSCII_8
    select ZMK_WPM

config ZMK_DONGLE_DISPLAY_DONGLE_BATTERY
    bool "Show also the battery level of the dongle"
    depends on BT && (!ZMK_SPLIT_BLE || ZMK_SPLIT_ROLE_CENTRAL)

config LV_Z_MEM_POOL_SIZE
    default 16384

endif
```

## config/boards/shields/dongle_display/Kconfig.shield
```kconfig
# Copyright (c) 2024 The ZMK Contributors
# SPDX-License-Identifier: MIT

config SHIELD_DONGLE_DISPLAY
	def_bool $(shields_list_contains,dongle_display)

if SHIELD_DONGLE_DISPLAY

config ZMK_DONGLE_DISPLAY_BONGO_CAT
	bool "Bongo cat animation widget"
	default y

config ZMK_DONGLE_DISPLAY_MODIFIERS
	bool "Modifier status widget"
	default y

config ZMK_DONGLE_DISPLAY_LAYER
	bool "Layer status widget"
	default y

config ZMK_DONGLE_DISPLAY_WPM
	bool "Words per minute widget"
	default y

config ZMK_DONGLE_DISPLAY_DONGLE_BATTERY
	bool "Include dongle battery level in widget"
	default y

config ZMK_DONGLE_DISPLAY_MAC_MODIFIERS
	bool "Show Mac-specific modifier symbols"
	default n

config ZMK_DONGLE_DISPLAY_WPM_DISABLED_LAYERS
	string "Layer names to disable WPM on"
	default ""

config ZMK_DONGLE_DISPLAY_LAYER_NAME_SCROLL_WIDTH
	int "Max width in pixels for scrolling layer name"
	default 30
	range 1 128

config ZMK_DONGLE_DISPLAY_LAYER_TEXT_ALIGN
	string "Text alignment for layer name"
	default "left"

endif # SHIELD_DONGLE_DISPLAY
```

## config/boards/shields/fifi/Kconfig.shield
```kconfig
# Copyright (c) 2024 The ZMK Contributors
# SPDX-License-Identifier: MIT

config SHIELD_FIFI_LEFT
    def_bool $(shields_list_contains,fifi_left)

config SHIELD_FIFI_RIGHT
    def_bool $(shields_list_contains,fifi_right)

config SHIELD_FIFI_DONGLE
    def_bool $(shields_list_contains,fifi_dongle)
```
